## conf/layer.conf
```bitbake
# We have a conf and classes directory, add to BBPATH
BBPATH .= ":${LAYERDIR}"

# We have recipes-* directories, add to BBFILES
BBFILES += "${LAYERDIR}/*.bb \
	${LAYERDIR}/*.bbappend"

BBFILE_COLLECTIONS += "ocaml"
BBFILE_PATTERN_ocaml = "^${LAYERDIR}/"
BBFILE_PRIORITY_ocaml = "6"
```
